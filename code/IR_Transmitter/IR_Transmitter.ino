#include <IRremote.h>
#include <avr/pgmspace.h>

String cmd;
boolean listening;
IRsend irsend;
int khz;
unsigned int buffer[199];

const PROGMEM unsigned int temp28[] = {4450,4250, 650,1450, 650,450, 650,1500, 650,1500, 650,400, 650,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1500, 650};
const PROGMEM unsigned int temp17[] = {4450,4250, 650,1450, 650,450, 650,1500, 650,1500, 650,400, 650,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1550, 600};
const PROGMEM unsigned int temp25[] = {4500,4200, 700,1450, 650,450, 650,1450, 700,1450, 700,400, 650,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1500, 650};
const PROGMEM unsigned int on[] = {4450,4250, 650,1450, 650,450, 650,1500, 650,1500, 650,400, 650,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1500, 650};
const PROGMEM unsigned int off[] = {4500,4250, 650,1450, 700,400, 650,1500, 600,1550, 650,400, 650,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1500, 700};

void setup() {
  Serial.begin(9600);
  listening=false;
  khz = 38;
  Serial.write("Connection Established\n");  
}

void loop() {
  if (Serial.available()) {
    cmd = Serial.readString();
    cleanInput();
    if(cmd == "disconnect") {
      Serial.write("Disconnected.\n");
      listening=false;
    } else if(listening) {
      if(cmd == "28") {
        sendSignal(temp28, (sizeof(temp28)/sizeof(temp28[0])));
        Serial.write("Increased capacity\n"); 
      } else if(cmd == "25") {
        sendSignal(temp25, (sizeof(temp25)/sizeof(temp25[0])));
        Serial.write("Moderated pool\n");
      } else if(cmd == "17") {
        sendSignal(temp17, (sizeof(temp17)/sizeof(temp17[0])));
        Serial.write("Reduced connections\n"); 
      } else if(cmd == "on") {
        sendSignal(on, (sizeof(on)/sizeof(on[0])));
        Serial.write("Server Started\n");
      } else if(cmd == "off") {
        sendSignal(off, (sizeof(off)/sizeof(off[0])));
        Serial.write("Server stopped\n");
      } else {
        Serial.write("Invalid command: "); 
        Serial.print(cmd);
        Serial.write("\n");
      }      
    } else if(cmd == "connect") {
      Serial.write("Listening...\n");
      listening=true;
    } else {
      Serial.write("Invalid command: "); 
      Serial.print(cmd);
      Serial.write("\n");
    }        
  }
}

void cleanInput() {
    if(cmd.endsWith("\n") || cmd.endsWith("\r")) 
      cmd.remove(cmd.length()-1);
    if(cmd.endsWith("\n") || cmd.endsWith("\r"))
      cmd.remove(cmd.length()-1);
    cmd.toLowerCase();
}

void sendSignal(const unsigned int data[], int size) {
  PGMtoIntArray(data, size);
  irsend.sendRaw(buffer, size, khz);
  //  Serial.println(size, DEC);
  //  Serial.println(buffer[3], DEC);
  //  Serial.println(buffer[199], DEC);
}

void PGMtoIntArray(const unsigned int data[], int size){
  for (byte i = 0; i < size; i++) {
    buffer[i]=pgm_read_word(&data[i]);
  }
}

